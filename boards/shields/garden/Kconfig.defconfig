## boards/shields/garden/Kconfig.defconfig
```kconfig
if SHIELD_GARDEN_LEFT

config ZMK_KEYBOARD_NAME
	default "Garden"

config ZMK_SPLIT_ROLE_CENTRAL
	default y

endif

if SHIELD_GARDEN_LEFT || SHIELD_GARDEN_RIGHT

config ZMK_SPLIT
	default y

endif
```

## boards/shields/garden/Kconfig.shield
```kconfig
config SHIELD_GARDEN_LEFT
	def_bool $(shields_list_contains,garden_left)

config SHIELD_GARDEN_RIGHT
	def_bool $(shields_list_contains,garden_right)
```
